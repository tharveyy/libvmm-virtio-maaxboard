/ {
    /delete-node/ chosen;
	/delete-node/ memory@40000000;

    memory@40000000 {
        device_type = "memory";
        reg = <0x00 0x40000000 0x00 0x10000000>;
    };

	chosen {
		#address-cells = <0x02>;
		#size-cells = <0x02>;
		ranges;
        stdout-path = "/virtio-console@0130000";
        linux,initrd-start = <0x00000000 0x4c000000>;
        linux,initrd-end = <0x00000000 0x4e000000>;

        bootargs = "console=hvc0 earlycon=hvc0 root=/dev/ram0 nosmp rw loglevel=8 pci=nomsi initcall_blacklist=imx8_soc_init earlyprintk=serial maxcpus=1";		// root=/dev/nfs nfsroot=/vmm-rfs
		// root=/dev/mmcblk0p1 rootwait
	};
};




/ {
    /delete-node/ chosen;
	/delete-node/ memory@40000000;

    memory@40000000 {
        device_type = "memory";
        reg = <0x00 0x40000000 0x00 0x10000000>;
    };

    chosen {
        stdout-path = "/soc@0/bus@30800000/serial@30860000";
        linux,initrd-start = <0x00000000 0x4c000000>;
        linux,initrd-end = <0x00000000 0x4e000000>;
        bootargs = "console=ttymxc0,115200 earlycon=ec_imx6q,0x30860000,115200 nosmp rw debug ignore_loglevel initcall_blacklist=imx8_soc_init pci=nomsi earlyprintk=serial maxcpus=1";
    };
};
