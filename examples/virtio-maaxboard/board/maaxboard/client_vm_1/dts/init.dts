/ {
    /delete-node/ chosen;
	/delete-node/ memory@40000000;

    memory@40000000 {
        device_type = "memory";
        reg = <0x00 0x40000000 0x00 0x10000000>;
    };
    
    chosen {
        linux,initrd-start = <0x00000000 0x4c000000>;
        linux,initrd-end = <0x00000000 0x4e000000>;

        bootargs = "console=hvc0 earlycon=hvc0 root=/dev/ram0 nosmp rw loglevel=8 pci=nomsi initcall_blacklist=imx8_soc_init maxcpus=1";		// root=/dev/nfs nfsroot=/vmm-rfs
		// root=/dev/mmcblk0p1 rootwait
    };

    virtio-console@0130000 {
		compatible = "virtio,mmio";
		reg = <0x00 0x130000 0x00 0x200>;
		interrupts = <0x00 42 0x04>;
	};
};

